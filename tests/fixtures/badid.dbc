BO_ 999999999 Bogus_Message: 8 VCU
 SG_ SomeSignal : 0|8@1+ (1,0) [0|255] "unit" AGENT
